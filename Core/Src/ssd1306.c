#include "ssd1306.h"

#include <string.h>

#define SSD1306_ADDR    (0x3C << 1)
#define SSD1306_TIMEOUT 100U

#define FB_SIZE (SSD1306_WIDTH * SSD1306_PAGES)

/* Framebuffer prefixed with the SSD1306 "data stream" control byte (0x40),
 * so one HAL_I2C_Master_Transmit pushes the whole frame in a single burst. */
static uint8_t           s_buf[1 + FB_SIZE];
static I2C_HandleTypeDef *s_hi2c;

#define FB (&s_buf[1])

/* 5x7 bitmap font padded with a trailing blank column => 6x8 cell.
 * Covers ASCII 0x20..0x7E. Each byte is one column of 8 vertical pixels;
 * bit 0 is the top pixel, bit 6 is the bottom of a 7-row glyph. */
static const uint8_t font6x8[95 * 6] = {
    0x00, 0x00, 0x00, 0x00, 0x00, 0x00, /*   */
    0x00, 0x00, 0x5F, 0x00, 0x00, 0x00, /* ! */
    0x00, 0x07, 0x00, 0x07, 0x00, 0x00, /* " */
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    0x08, 0x04, 0x08, 0x10, 0x08, 0x00, /* ~ */
};

/* Maps each 4-bit source nibble to an 8-bit value with every source bit
 * duplicated, so 7-row font columns expand to 14 rows for 2x scale. */
static const uint8_t bit_double_lut[16] = {
    0x00, 0x03, 0x0C, 0x0F, 0x30, 0x33, 0x3C, 0x3F,
    0xC0, 0xC3, 0xCC, 0xCF, 0xF0, 0xF3, 0xFC, 0xFF,
};

static const uint8_t init_cmds[] = {
    0x00,              /* control byte: next bytes are commands */
    0xAE,              /* display off */
    0xD5, 0x80,        /* display clock divide ratio / oscillator */
    0xA8, 0x1F,        /* multiplex ratio: 31 (for 32 rows) */
    0xD3, 0x00,        /* display offset = 0 */
    0x40,              /* start line = 0 */
    0x8D, 0x14,        /* enable charge pump */
    0x20, 0x00,        /* addressing mode: horizontal */
    0xA1,              /* segment remap: col 127 -> SEG0 */
    0xC8,              /* COM scan direction remapped */
    0xDA, 0x02,        /* COM pins hardware config for 128x32 */
    0x81, 0x8F,        /* contrast */
    0xD9, 0xF1,        /* pre-charge period */
    0xDB, 0x40,        /* Vcomh deselect level */
    0xA4,              /* resume display from RAM */
    0xA6,              /* normal (non-inverted) display */
                       /* display left OFF; caller turns it on via ssd1306_display_on() */
};

static const uint8_t flush_cmds[] = {
    0x00,                         /* control byte: commands */
    0x21, 0, SSD1306_WIDTH - 1,   /* column address window: 0..127 */
    0x22, 0, SSD1306_PAGES - 1,   /* page address window: 0..3 */
};

HAL_StatusTypeDef ssd1306_init(I2C_HandleTypeDef *hi2c)
{
    s_hi2c   = hi2c;
    s_buf[0] = 0x40;   /* control byte: data stream */
    ssd1306_clear();

    HAL_StatusTypeDef rc = HAL_I2C_Master_Transmit(s_hi2c, SSD1306_ADDR,
                                                   (uint8_t *)init_cmds,
                                                   sizeof(init_cmds),
                                                   SSD1306_TIMEOUT);
    if (rc != HAL_OK) {
        return rc;
    }
    return ssd1306_flush();
}

void ssd1306_clear(void)
{
    memset(FB, 0x00, FB_SIZE);
}

void ssd1306_draw_text(uint8_t page, uint8_t col, const char *s)
{
    /* 2x scale: glyph is 12 columns wide, 2 pages (16 rows) tall. */
    if ((uint16_t)page + 2U > SSD1306_PAGES) {
        return;
    }
    for (; *s; s++) {
        if (col + 12U > SSD1306_WIDTH) {
            break;
        }
        uint8_t c = (uint8_t)*s;
        if (c < 0x20 || c > 0x7E) {
            c = 0x20;
        }
        const uint8_t *glyph = &font6x8[(c - 0x20) * 6];
        uint8_t *row0 = &FB[(uint16_t)page * SSD1306_WIDTH + col];
        uint8_t *row1 = row0 + SSD1306_WIDTH;
        for (uint8_t i = 0; i < 6; i++) {
            uint8_t b   = glyph[i];
            uint8_t top = bit_double_lut[b & 0x0F];
            uint8_t bot = bit_double_lut[(b >> 4) & 0x0F];
            row0[i * 2]     = top;
            row0[i * 2 + 1] = top;
            row1[i * 2]     = bot;
            row1[i * 2 + 1] = bot;
        }
        col += 12;
    }
}

HAL_StatusTypeDef ssd1306_flush(void)
{
    HAL_StatusTypeDef rc = HAL_I2C_Master_Transmit(s_hi2c, SSD1306_ADDR,
                                                   (uint8_t *)flush_cmds,
                                                   sizeof(flush_cmds),
                                                   SSD1306_TIMEOUT);
    if (rc != HAL_OK) {
        return rc;
    }
    return HAL_I2C_Master_Transmit(s_hi2c, SSD1306_ADDR, s_buf,
                                   1 + FB_SIZE, SSD1306_TIMEOUT);
}

static HAL_StatusTypeDef send_cmd(uint8_t cmd)
{
    uint8_t buf[2] = { 0x00, cmd };
    return HAL_I2C_Master_Transmit(s_hi2c, SSD1306_ADDR, buf,
                                   sizeof(buf), SSD1306_TIMEOUT);
}

HAL_StatusTypeDef ssd1306_display_on(void)  { return send_cmd(0xAF); }
HAL_StatusTypeDef ssd1306_display_off(void) { return send_cmd(0xAE); }
